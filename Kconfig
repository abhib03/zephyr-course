## Kconfig
```kconfig
mainmenu "Zephyr Course Application"

source "Kconfig.zephyr"
rsource "drivers/Kconfig"
```

## app/build/Kconfig/boards/Kconfig.defconfig
```kconfig
# Load Zephyr board defconfig descriptions.
osource "D:/zephyrproject/zephyr/boards/others/esp32c3_supermini/Kconfig.defconfig"
```

## app/build/Kconfig/boards/Kconfig.esp32c3_supermini
```kconfig
# Load board Kconfig descriptions.
osource "D:/zephyrproject/zephyr/boards/others/esp32c3_supermini/Kconfig.esp32c3_supermini"
```

## app/build/Kconfig/boards/Kconfig.sysbuild
```kconfig
# Load Sysbuild board Kconfig descriptions.
osource "D:/zephyrproject/zephyr/boards/others/esp32c3_supermini/Kconfig.sysbuild"
```

## boards/espressif/my_board_v2/Kconfig.my_board_v2
```kconfig
# Copyright (c) 2026
# SPDX-License-Identifier: Apache-2.0

config BOARD_MY_BOARD_V2
select SOC_ESP32C3
```

## boards/espressif/my_custom_board_esp32c3/Kconfig.my_custom_board_esp32c3
```kconfig
# ESP32-C3 custom board configuration

# SPDX-License-Identifier: Apache-2.0

config BOARD_MY_CUSTOM_BOARD_ESP32C3
        select SOC_ESP32C3_MINI_N4
```

## boards/espressif/my_custom_board_esp32c3/board.yml
```yaml
board:
  name: my_custom_board_esp32c3
  vendor: espressif
  socs:
    - name: esp32c3
```

## drivers/sensor/led_sensor/Kconfig
```kconfig
menuconfig LED_SENSOR
bool "LED Sensor driver"
default y
depends on DT_HAS_ZEPHYR_LED_SENSOR_ENABLED
select GPIO
help
  Enable custom LED sensor driver.
```

## dts/bindings/sensor/zephyr,led-sensor.yaml
```yaml
description: Fake sensor driven by an on-board LED

compatible: "zephyr,led-sensor"

include: base.yaml

properties:
  led-gpios:
    type: phandle-array
    required: true
    description: GPIO connected to the LED
```

## dts/bindings/sensor/zephyr_led_sensor.yaml
```yaml
description: Custom LED sensor driver
compatible: "zephyr,led-sensor"
include: sensor-device.yaml

properties:
  led-gpios:
    type: phandle-array
    required: true
    description: GPIO pin connected to the LED sensor
```
