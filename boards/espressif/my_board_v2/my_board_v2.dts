/*
 * SPDX-License-Identifier: Apache-2.0
 */

/dts-v1/;

#include <espressif/esp32c3/esp32c3_mini_n4.dtsi>
#include "my_board_v2-pinctrl.dtsi"
#include <espressif/partitions_0x0_default.dtsi>

/ {
model = "My Board V2 (From Scratch)";
compatible = "espressif,my_board_v2", "espressif,esp32c3";

chosen {
zephyr,sram = &sram1;
zephyr,console = &uart0;
zephyr,shell-uart = &uart0;
zephyr,flash = &flash0;
zephyr,code-partition = &slot0_partition;
};
};

&uart0 {
status = "okay";
current-speed = <115200>;
pinctrl-0 = <&uart0_default>;
pinctrl-names = "default";
};

&gpio0 {
status = "okay";
};
